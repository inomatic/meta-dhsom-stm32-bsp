## scripts/lib/wic/canned-wks/emmcimage-stm32mp13.wks
```
# short-description: Create DH STM32MP13 eMMCcard image with a boot partition
# long-description: Creates a partitioned eMMC card image. Boot files
# are located in the first ext4 partition.

part / --source rootfs --ondisk mmcblk0 --fstype ext4 --label root-a --part-name "rootfs-a" --align 4096 --use-uuid --active --fixed-size 512M
#part /mnt/root-b --ondisk mmcblk0 --fstype ext4 --label root-b --part-name "rootfs-b" --align 4096 --use-uuid --fixed-size 512M
#part /mnt/user --ondisk mmcblk0 --fstype ext4 --label user --part-name "userfs" --align 4096 --fixed-size 1G

bootloader --ptable gpt
```
